## firmware/apps/hub/main/Kconfig.projbuild
```kconfig
menu "Lochness hub"

    config HUB_VENDOR_NAME
        string "Vendor name (Matter Basic Information, max 32)"
        default "Lochness"

    config HUB_PRODUCT_NAME
        string "Product name (Matter Basic Information, max 32)"
        default "Lochness Hub"
        help
            Controllers name the accessory after this; Apple Home shows it
            as the default accessory name.

    config HUB_PRODUCT_URL
        string "Product URL (empty = none)"
        default ""

    config HUB_TZ
        string "Local time zone (POSIX TZ string)"
        default "UTC0"
        help
            Sent to the lock with the time so weekday schedules use local
            time. Examples: "UTC0", "EST5EDT,M3.2.0,M11.1.0",
            "PST8PDT,M3.2.0,M11.1.0", "CET-1CEST,M3.5.0,M10.5.0/3".

    config HUB_SNTP_SERVER
        string "SNTP server (empty = off)"
        default "pool.ntp.org"
        help
            Where the hub gets UTC. This is the hub's only traffic beyond the
            local network. Point it at your router if it serves NTP, or
            leave it empty to rely on the Matter controller (not yet
            implemented), in which case schedules deny until time is known.

endmenu
```

## firmware/apps/hub/sdkconfig.defaults
```kconfig
# Lochness hub: Matter Door Lock over Wi-Fi on an ESP32-C6-DevKitC-1.
# Based on esp-matter's light example defaults (cluster exclusions included),
# with the Door Lock cluster enabled and BLE kept up after commissioning for
# the link to the lock.
CONFIG_IDF_TARGET="esp32c6"
CONFIG_ESPTOOLPY_FLASHSIZE_4MB=y
CONFIG_FREERTOS_HZ=1000

# Bluetooth: Matter commissioning (peripheral) and the lock link (central)
CONFIG_BT_ENABLED=y
CONFIG_BT_NIMBLE_ENABLED=y
CONFIG_BT_NIMBLE_ENABLE_CONN_REATTEMPT=n
CONFIG_BT_NIMBLE_ROLE_CENTRAL=y
CONFIG_BT_NIMBLE_ROLE_OBSERVER=y
CONFIG_BT_NIMBLE_ROLE_PERIPHERAL=y
CONFIG_BT_NIMBLE_ROLE_BROADCASTER=y
CONFIG_BT_NIMBLE_MAX_CONNECTIONS=2
CONFIG_BT_NIMBLE_ATT_PREFERRED_MTU=247
CONFIG_BT_NIMBLE_LOG_LEVEL_WARNING=y
# The lock link needs BLE after commissioning; don't let Matter tear it down.
CONFIG_USE_BLE_ONLY_FOR_COMMISSIONING=n

# Matter
CONFIG_ENABLE_OTA_REQUESTOR=n
# Names and serial from main/device_info.cpp (see HUB_* in menuconfig).
CONFIG_CUSTOM_DEVICE_INSTANCE_INFO_PROVIDER=y
CONFIG_DEVICE_SOFTWARE_VERSION_NUMBER=1
CONFIG_DEFAULT_DEVICE_HARDWARE_VERSION=1
# BLE name while commissioning: prefix + 4-digit discriminator (16 chars max).
CONFIG_BLE_DEVICE_NAME_PREFIX="Lochness-"
#enable lwip ipv6 autoconfig
CONFIG_LWIP_IPV6_AUTOCONFIG=y

# Use a custom partition table
CONFIG_PARTITION_TABLE_CUSTOM=y
CONFIG_PARTITION_TABLE_FILENAME="partitions.csv"
CONFIG_PARTITION_TABLE_OFFSET=0xC000

# Enable chip shell
CONFIG_ENABLE_CHIP_SHELL=y

CONFIG_ENABLE_WIFI_AP=n

#enable lwIP route hooks
CONFIG_LWIP_HOOK_IP6_ROUTE_DEFAULT=y
CONFIG_LWIP_HOOK_ND6_GET_GW_DEFAULT=y

# This example only use 2 dynamic endpoints
CONFIG_ESP_MATTER_MAX_DYNAMIC_ENDPOINT_COUNT=2


# disable softap by default
CONFIG_ESP_WIFI_SOFTAP_SUPPORT=n


# Enable HKDF in mbedtls
CONFIG_MBEDTLS_HKDF_C=y

# Increase LwIP IPv6 address number to 6 (MAX_FABRIC + 1)
# unique local addresses for fabrics(MAX_FABRIC), a link local address(1)
CONFIG_LWIP_IPV6_NUM_ADDRESSES=6

# Exclude unused clusters to optimize flash and memory usage
CONFIG_SUPPORT_ACCOUNT_LOGIN_CLUSTER=n
CONFIG_SUPPORT_ACTIONS_CLUSTER=n
CONFIG_SUPPORT_ACTIVATED_CARBON_FILTER_MONITORING_CLUSTER=n
CONFIG_SUPPORT_AIR_QUALITY_CLUSTER=n
CONFIG_SUPPORT_APPLICATION_BASIC_CLUSTER=n
CONFIG_SUPPORT_APPLICATION_LAUNCHER_CLUSTER=n
CONFIG_SUPPORT_AUDIO_OUTPUT_CLUSTER=n
CONFIG_SUPPORT_BOOLEAN_STATE_CLUSTER=n
CONFIG_SUPPORT_BOOLEAN_STATE_CONFIGURATION_CLUSTER=n
CONFIG_SUPPORT_BRIDGED_DEVICE_BASIC_INFORMATION_CLUSTER=n
CONFIG_SUPPORT_CAMERA_AV_SETTINGS_USER_LEVEL_MANAGEMENT_CLUSTER=n
CONFIG_SUPPORT_CARBON_DIOXIDE_CONCENTRATION_MEASUREMENT_CLUSTER=n
CONFIG_SUPPORT_CARBON_MONOXIDE_CONCENTRATION_MEASUREMENT_CLUSTER=n
CONFIG_SUPPORT_CHANNEL_CLUSTER=n
CONFIG_SUPPORT_CHIME_CLUSTER=n
CONFIG_SUPPORT_CLOSURE_CONTROL_CLUSTER=n
CONFIG_SUPPORT_CLOSURE_DIMENSION_CLUSTER=n
CONFIG_SUPPORT_COMMISSIONER_CONTROL_CLUSTER=n
CONFIG_SUPPORT_COMMODITY_METERING_CLUSTER=n
CONFIG_SUPPORT_COMMODITY_PRICE_CLUSTER=n
CONFIG_SUPPORT_COMMODITY_TARIFF_CLUSTER=n
CONFIG_SUPPORT_CONTENT_LAUNCHER_CLUSTER=n
CONFIG_SUPPORT_CONTENT_CONTROL_CLUSTER=n
CONFIG_SUPPORT_CONTENT_APP_OBSERVER_CLUSTER=n
CONFIG_SUPPORT_DEVICE_ENERGY_MANAGEMENT_CLUSTER=n
CONFIG_SUPPORT_DEVICE_ENERGY_MANAGEMENT_MODE_CLUSTER=n
CONFIG_SUPPORT_DIAGNOSTIC_LOGS_CLUSTER=n
CONFIG_SUPPORT_DISHWASHER_ALARM_CLUSTER=n
CONFIG_SUPPORT_DISHWASHER_MODE_CLUSTER=n
CONFIG_SUPPORT_ELECTRICAL_GRID_CONDITIONS_CLUSTER=n
CONFIG_SUPPORT_HUMIDISTAT_CLUSTER=n
CONFIG_SUPPORT_METER_IDENTIFICATION_CLUSTER=n
CONFIG_SUPPORT_MICROWAVE_OVEN_MODE_CLUSTER=n
CONFIG_SUPPORT_ECOSYSTEM_INFORMATION_CLUSTER=n
CONFIG_SUPPORT_ELECTRICAL_ENERGY_MEASUREMENT_CLUSTER=n
CONFIG_SUPPORT_ELECTRICAL_POWER_MEASUREMENT_CLUSTER=n
CONFIG_SUPPORT_ENERGY_EVSE_CLUSTER=n
CONFIG_SUPPORT_ENERGY_EVSE_MODE_CLUSTER=n
CONFIG_SUPPORT_ETHERNET_NETWORK_DIAGNOSTICS_CLUSTER=n
CONFIG_SUPPORT_ENERGY_PREFERENCE_CLUSTER=n
CONFIG_SUPPORT_FAN_CONTROL_CLUSTER=n
CONFIG_SUPPORT_FAULT_INJECTION_CLUSTER=n
CONFIG_SUPPORT_FIXED_LABEL_CLUSTER=n
CONFIG_SUPPORT_FLOW_MEASUREMENT_CLUSTER=n
CONFIG_SUPPORT_FORMALDEHYDE_CONCENTRATION_MEASUREMENT_CLUSTER=n
CONFIG_SUPPORT_HEPA_FILTER_MONITORING_CLUSTER=n
CONFIG_SUPPORT_ICD_MANAGEMENT_CLUSTER=n
CONFIG_SUPPORT_ILLUMINANCE_MEASUREMENT_CLUSTER=n
CONFIG_SUPPORT_JOINT_FABRIC_DATASTORE_CLUSTER=n
CONFIG_SUPPORT_JOINT_FABRIC_ADMINISTRATOR_CLUSTER=n
CONFIG_SUPPORT_KEYPAD_INPUT_CLUSTER=n
CONFIG_SUPPORT_LAUNDRY_WASHER_MODE_CLUSTER=n
CONFIG_SUPPORT_LOCALIZATION_CONFIGURATION_CLUSTER=n
CONFIG_SUPPORT_LOW_POWER_CLUSTER=n
CONFIG_SUPPORT_MEDIA_INPUT_CLUSTER=n
CONFIG_SUPPORT_MEDIA_PLAYBACK_CLUSTER=n
CONFIG_SUPPORT_MICROWAVE_OVEN_CONTROL_CLUSTER=n
CONFIG_SUPPORT_MESSAGES_CLUSTER=n
CONFIG_SUPPORT_MODE_SELECT_CLUSTER=n
CONFIG_SUPPORT_NETWORK_IDENTITY_MANAGEMENT_CLUSTER=n
CONFIG_SUPPORT_NITROGEN_DIOXIDE_CONCENTRATION_MEASUREMENT_CLUSTER=n
CONFIG_SUPPORT_PROXIMITY_RANGING_CLUSTER=n
CONFIG_SUPPORT_PUSH_AV_STREAM_TRANSPORT_CLUSTER=n
CONFIG_SUPPORT_SAMPLE_MEI_CLUSTER=n
CONFIG_SUPPORT_OCCUPANCY_SENSING_CLUSTER=n
CONFIG_SUPPORT_POWER_TOPOLOGY_CLUSTER=n
CONFIG_SUPPORT_OPERATIONAL_STATE_CLUSTER=n
CONFIG_SUPPORT_OPERATIONAL_STATE_OVEN_CLUSTER=n
CONFIG_SUPPORT_OPERATIONAL_STATE_RVC_CLUSTER=n
CONFIG_SUPPORT_OVEN_MODE_CLUSTER=n
CONFIG_SUPPORT_OZONE_CONCENTRATION_MEASUREMENT_CLUSTER=n
CONFIG_SUPPORT_PM10_CONCENTRATION_MEASUREMENT_CLUSTER=n
CONFIG_SUPPORT_PM1_CONCENTRATION_MEASUREMENT_CLUSTER=n
CONFIG_SUPPORT_PM2_5_CONCENTRATION_MEASUREMENT_CLUSTER=n
CONFIG_SUPPORT_POWER_SOURCE_CLUSTER=n
CONFIG_SUPPORT_POWER_SOURCE_CONFIGURATION_CLUSTER=n
CONFIG_SUPPORT_PRESSURE_MEASUREMENT_CLUSTER=n
CONFIG_SUPPORT_PUMP_CONFIGURATION_AND_CONTROL_CLUSTER=n
CONFIG_SUPPORT_RADON_CONCENTRATION_MEASUREMENT_CLUSTER=n
CONFIG_SUPPORT_REFRIGERATOR_ALARM_CLUSTER=n
CONFIG_SUPPORT_REFRIGERATOR_AND_TEMPERATURE_CONTROLLED_CABINET_MODE_CLUSTER=n
CONFIG_SUPPORT_RELATIVE_HUMIDITY_MEASUREMENT_CLUSTER=n
CONFIG_SUPPORT_RVC_CLEAN_MODE_CLUSTER=n
CONFIG_SUPPORT_RVC_RUN_MODE_CLUSTER=n
CONFIG_SUPPORT_SERVICE_AREA_CLUSTER=n
CONFIG_SUPPORT_SMOKE_CO_ALARM_CLUSTER=n
CONFIG_SUPPORT_SOFTWARE_DIAGNOSTICS_CLUSTER=n
CONFIG_SUPPORT_SOIL_MEASUREMENT_CLUSTER=n
CONFIG_SUPPORT_SWITCH_CLUSTER=n
CONFIG_SUPPORT_TARGET_NAVIGATOR_CLUSTER=n
CONFIG_SUPPORT_TEMPERATURE_CONTROL_CLUSTER=n
CONFIG_SUPPORT_TEMPERATURE_MEASUREMENT_CLUSTER=n
CONFIG_SUPPORT_THERMOSTAT_CLUSTER=n
CONFIG_SUPPORT_THERMOSTAT_USER_INTERFACE_CONFIGURATION_CLUSTER=n
CONFIG_SUPPORT_TIME_FORMAT_LOCALIZATION_CLUSTER=n
CONFIG_SUPPORT_TIME_SYNCHRONIZATION_CLUSTER=n
CONFIG_SUPPORT_TIMER_CLUSTER=n
CONFIG_SUPPORT_TLS_CERTIFICATE_MANAGEMENT_CLUSTER=n
CONFIG_SUPPORT_TLS_CLIENT_MANAGEMENT_CLUSTER=n
CONFIG_SUPPORT_TVOC_CONCENTRATION_MEASUREMENT_CLUSTER=n
CONFIG_SUPPORT_UNIT_LOCALIZATION_CLUSTER=n
CONFIG_SUPPORT_UNIT_TESTING_CLUSTER=n
CONFIG_SUPPORT_USER_LABEL_CLUSTER=n
CONFIG_SUPPORT_VALVE_CONFIGURATION_AND_CONTROL_CLUSTER=n
CONFIG_SUPPORT_WAKE_ON_LAN_CLUSTER=n
CONFIG_SUPPORT_LAUNDRY_WASHER_CONTROLS_CLUSTER=n
CONFIG_SUPPORT_LAUNDRY_DRYER_CONTROLS_CLUSTER=n
CONFIG_SUPPORT_WEB_RTC_TRANSPORT_PROVIDER_CLUSTER=n
CONFIG_SUPPORT_WEB_RTC_TRANSPORT_REQUESTOR_CLUSTER=n
CONFIG_SUPPORT_WIFI_NETWORK_MANAGEMENT_CLUSTER=n
CONFIG_SUPPORT_WINDOW_COVERING_CLUSTER=n
CONFIG_SUPPORT_WATER_HEATER_MANAGEMENT_CLUSTER=n
CONFIG_SUPPORT_WATER_HEATER_MODE_CLUSTER=n
CONFIG_SUPPORT_ZONE_MANAGEMENT_CLUSTER=n

# Exclude newly added clusters (Matter 1.5/1.6) that are not used by the light device type
CONFIG_SUPPORT_AMBIENT_CONTEXT_SENSING_CLUSTER=n
CONFIG_SUPPORT_CAMERA_AV_STREAM_MANAGEMENT_CLUSTER=n
CONFIG_SUPPORT_MEDIA_FILE_MANAGEMENT_CLUSTER=n

# TC_RR_1_1 requires MaxGroupKeysPerFabric >= 4 (chip esp32 Kconfig defaults to 3)
CONFIG_MAX_GROUP_KEYS_PER_FABRIC=4
```

## firmware/apps/keypad/main/Kconfig.projbuild
```kconfig
menu "Lochness keypad"

    config KEYPAD_FW_MAJOR
        int "Firmware major version"
        default 0
    config KEYPAD_FW_MINOR
        int "Firmware minor version"
        default 1

    menu "Button matrix (3 columns x 4 rows)"
        config KEYPAD_MATRIX
            bool "Enable 3x4 button matrix"
            default n
            help
                Layout:  1 2 3 / 4 5 6 / 7 8 9 / * 0 #
                Rows are driven low one at a time; columns are inputs with
                pull-ups. '*' clears, '#' unlocks.
        config KEYPAD_ROW0_GPIO
            int "Row 0 GPIO"
            depends on KEYPAD_MATRIX
            default 0
        config KEYPAD_ROW1_GPIO
            int "Row 1 GPIO"
            depends on KEYPAD_MATRIX
            default 1
        config KEYPAD_ROW2_GPIO
            int "Row 2 GPIO"
            depends on KEYPAD_MATRIX
            default 2
        config KEYPAD_ROW3_GPIO
            int "Row 3 GPIO"
            depends on KEYPAD_MATRIX
            default 3
        config KEYPAD_COL0_GPIO
            int "Column 0 GPIO"
            depends on KEYPAD_MATRIX
            default 4
        config KEYPAD_COL1_GPIO
            int "Column 1 GPIO"
            depends on KEYPAD_MATRIX
            default 5
        config KEYPAD_COL2_GPIO
            int "Column 2 GPIO"
            depends on KEYPAD_MATRIX
            default 6
    endmenu

    config KEYPAD_LOCK_BUTTON_GPIO
        int "Lock button GPIO (-1 = none)"
        range -1 30
        default -1
        help
            Dedicated one-touch lock button, active low.

    config KEYPAD_PAIR_BUTTON_GPIO
        int "Pair button GPIO (-1 = none; DevKitC BOOT button is GPIO 9)"
        range -1 30
        default 9
        help
            Hold for 3 seconds to enter pairing mode. On the production
            keypad this sits behind the mounting plate.

    config KEYPAD_STATUS_LED_GPIO
        int "Status RGB LED (WS2812) GPIO (-1 = none)"
        range -1 30
        default 8
        help
            The DevKitC-1's onboard RGB LED (GPIO 8): white while starting,
            blinking blue while pairing, amber when not paired, green when
            paired and ready. Bench aid; off on a battery keypad.

    config KEYPAD_STATUS_LED_BRIGHTNESS
        int "Status LED brightness (1-255)"
        range 1 255
        default 24

    config KEYPAD_LED_GREEN_GPIO
        int "Green LED GPIO (-1 = none)"
        range -1 30
        default -1
    config KEYPAD_LED_RED_GPIO
        int "Red LED GPIO (-1 = none)"
        range -1 30
        default -1
    config KEYPAD_BUZZER_GPIO
        int "Piezo buzzer GPIO (-1 = none)"
        range -1 30
        default -1

    menu "Battery sense"
        config KEYPAD_BATTERY_ADC_GPIO
            int "Battery divider ADC GPIO (-1 = none)"
            range -1 6
            default -1
            help
                ADC1 pin wired to the midpoint of a divider across the
                battery (ESP32-C6: GPIO 0-6). With -1 the keypad reports
                its battery as unknown (0 mV), as the DevKit has no
                divider. Use high-value resistors (for example 2 x 1 MOhm
                with 100 nF to GND) so the divider barely drains the cells.
        config KEYPAD_BATTERY_DIVIDER_PCT
            int "Battery voltage as a percentage of the ADC pin voltage"
            depends on KEYPAD_BATTERY_ADC_GPIO >= 0
            range 100 1000
            default 200
            help
                200 for a divider of two equal resistors.
        config KEYPAD_BATTERY_LOW_MV
            int "Low-battery threshold (mV)"
            depends on KEYPAD_BATTERY_ADC_GPIO >= 0
            default 2400
            help
                Below this the keypad sets the low-battery flag. 2400 mV
                suits 2 x AA lithium cells.
    endmenu

    comment "Capacitive touch keys: backend pending touch-controller selection"

endmenu
```
