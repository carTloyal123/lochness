## firmware/apps/lock_unit/main/Kconfig.projbuild
```kconfig
menu "Lochness lock unit"

    config LOCHNESS_DOOR_GPIO
        int "Door reed switch GPIO (-1 = none, use 'sim door')"
        range -1 30
        default -1
        help
            Reed switch to GND with internal pull-up. Closed contact (magnet
            present) means the door is closed.

    config LOCHNESS_SIM_MOTOR_MS
        int "Simulated motor travel time (ms)"
        default 800
        help
            Until the H-bridge/encoder driver lands, the motor is simulated
            and reports success after this delay.

    config LOCHNESS_STATUS_LED_GPIO
        int "Status RGB LED (WS2812) GPIO (-1 = none)"
        range -1 30
        default 8
        help
            Shows the bolt state on the DevKitC-1's onboard RGB LED
            (GPIO 8): red locked, green unlocked, amber moving, blinking red
            jammed, blinking blue while a pairing window is open. Three
            green blinks after boot mean the lock is ready.

    config LOCHNESS_STATUS_LED_BRIGHTNESS
        int "Status LED brightness (1-255)"
        range 1 255
        default 24
        depends on LOCHNESS_STATUS_LED_GPIO >= 0

    config LOCHNESS_ADV_INTERVAL_MS
        int "Advertising interval when idle (ms)"
        range 100 2000
        default 300
        help
            How often the lock advertises to its keypad and phones. A
            peer waits on average about half of this to connect. Each
            advertising event costs a fixed amount of energy, so the
            radio's average current scales roughly with 1 / interval.
            Measure on the real board before choosing a production value.

    menu "Matter"

        config LOCHNESS_VENDOR_NAME
            string "Vendor name (Matter Basic Information, max 32)"
            default "Lochness"

        config LOCHNESS_PRODUCT_NAME
            string "Product name (Matter Basic Information, max 32)"
            default "Lochness Lock"
            help
                Controllers name the accessory after this; Apple Home shows
                it as the default accessory name.

        config LOCHNESS_PRODUCT_URL
            string "Product URL (empty = none)"
            default ""

        config LOCHNESS_SUBSCRIPTION_MAX_INTERVAL_S
            int "Longest silence on a subscription (s, 0 = controller's choice)"
            range 0 3600
            default 60
            help
                Caps the max interval the lock grants a subscribing
                controller. The lock must report at least this often, even
                with nothing changed, and the controller treats a missed
                report as a dead subscription and resubscribes. Apple Home
                asks for 600 s, so a subscription lost to radio trouble left
                Home showing stale state (stuck on "Unlocking") for up to
                about 10 minutes; 60 s bounds that to about a minute, at the
                cost of one small keep-alive report per minute.

                TODO(production): 60 s is a development value. A battery lock
                (sleepy end device / Matter ICD) wakes its radio for every
                keep-alive, so measure the power cost and choose a production
                value with the power work. An ICD also cannot grant less than
                its idle mode duration, so revisit this then.

    endmenu

endmenu
```

## firmware/components/platform_esp/Kconfig
```kconfig
menu "Lochness platform"

    choice LOCHNESS_PIN_KEY
        prompt "PIN digest key source"
        default LOCHNESS_PIN_KEY_DEV_NVS
        help
            Where the HMAC key that protects stored PIN digests lives.

        config LOCHNESS_PIN_KEY_DEV_NVS
            bool "Development: random key stored in NVS (INSECURE)"
            help
                A random key is generated on first boot and stored in NVS.
                Without flash/NVS encryption, anyone who dumps the flash can
                brute-force every PIN offline. Use only on dev boards.

        config LOCHNESS_PIN_KEY_EFUSE
            bool "Production: eFuse HMAC key (hardware-bound)"
            help
                PIN digests are computed by the HMAC peripheral using a key
                burned into an eFuse key block with purpose HMAC_UP. Software
                cannot read the key. Burning eFuses is irreversible.
    endchoice

    config LOCHNESS_PIN_KEY_EFUSE_BLOCK
        int "eFuse HMAC key block (0-5)"
        depends on LOCHNESS_PIN_KEY_EFUSE
        range 0 5
        default 4

endmenu
```
